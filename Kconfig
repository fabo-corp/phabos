## Kconfig
```kconfig
# Copyright (C) 2014-2015 Fabien Parent. All rights reserved.
# Author: Fabien Parent <parent.f@gmail.com>
#
# Provided under the three clause BSD license found in the LICENSE file.

mainmenu "phabos kernel configuration"

config ARCH
    string
    option env="ARCH"

source "arch/$ARCH/Kconfig"
source kernel/Kconfig
source drivers/Kconfig
source fs/Kconfig
source scripts/Kconfig
```

## apps/Kconfig
```kconfig
menu "Applications"

config APP_GREYBUS_UTILS
    bool

config APP_APBRIDGEA
    bool "APBridge-A"
    select APP_GREYBUS_UTILS

config APP_SVC
    bool "SVC"
    depends on BOARD_ARA_SVC
    select APP_GREYBUS_UTILS

config APP_GPIO
    bool "GPIO"
    select GPIO

config APP_I2S
    bool "I2S"
    select ARA_BACKPORT

config APP_UNIPRO
    bool "UniPro"
    select UNIPRO

config APP_FREE
    bool "free"

config APP_LS
    bool "ls"

config APP_YES
    bool "yes"

config APP_I2CDETECT
    bool "i2cdetect"

config APP_TERM
    bool "term"

if MACH_TSB
source apps/tsb/Kconfig
endif

endmenu
```

## apps/tsb/Kconfig
```kconfig
config APP_TSB_ETM
    bool "TSB ETM"

config APP_TSB_PINSHARE
    bool "TSB Pinshare"
```

## arch/arm/Kconfig
```kconfig
# Copyright (C) 2014-2015 Fabien Parent. All rights reserved.
# Author: Fabien Parent <parent.f@gmail.com>
#
# Provided under the three clause BSD license found in the LICENSE file.

menu "System configuration"

config CPU_ARM
    bool
    default y

config CPU_ARMV7
    bool
    select CPU_ARM

config CPU_ARM_THUMB
    bool

config CPU_ARMV7M
    bool
    select CPU_ARMV7
    select CPU_ARM_THUMB

config CPU_ARM_CORTEX_M3
    bool
    select CPU_ARMV7M

config CPU_ARM_CORTEX_M4
    bool
    select CPU_ARMV7M

config BIG_ENDIAN
    bool

config LITTLE_ENDIAN
    bool

choice
    prompt "Machine"

    config MACH_TSB
        bool "Toshiba Bridge"

    config MACH_STELLARIS
        bool "TI Stellaris"

    config MACH_STM32
        bool "STM32"
endchoice

if MACH_TSB
source "arch/$ARCH/mach-tsb/Kconfig"
endif

if MACH_STELLARIS
source "arch/$ARCH/mach-stellaris/Kconfig"
endif

if MACH_STM32
source "arch/$ARCH/mach-stm32/Kconfig"
endif

config ARCH_HAS_SCHEDULER_WATCHDOG
    bool
    default y

choice
    prompt "Boot Mode"

    config BOOT_FLASH
        bool "boot from flash"

    config BOOT_COPYTORAM
        bool "boot from flash then copy to ram"

    config BOOT_RAM
        bool "boot from ram"
endchoice

if CPU_ARMV7M
source "arch/$ARCH/arm-v7m/Kconfig"
endif

source "arch/$ARCH/common/Kconfig"

endmenu
```

## arch/arm/common/Kconfig
```kconfig
# Copyright (C) 2015 Fabien Parent. All rights reserved.
# Author: Fabien Parent <parent.f@gmail.com>
#
# Provided under the three clause BSD license found in the LICENSE file.

menuconfig ARM_SEMIHOSTING
    bool "ARM Semihosting"
    select SERIAL

if ARM_SEMIHOSTING
    config ARM_SEMIHOSTING_LOWIO
        bool "Use ARM Semihosting for lowio"
endif
```

## arch/arm/mach-stellaris/Kconfig
```kconfig
# Copyright (C) 2014-2015 Fabien Parent. All rights reserved.
# Author: Fabien Parent <parent.f@gmail.com>
#
# Provided under the three clause BSD license found in the LICENSE file.

config MACH_NAME
    string
    default "stellaris"

choice
    prompt "Board"

    config BOARD_LM3S6965
        bool "Luminaris Cortex-M3 S6965"
        select CPU_ARM_CORTEX_M3
endchoice

config MACH_LINKER_SCRIPT
    string
    default "lm3s6965"
```

## arch/arm/mach-stm32/Kconfig
```kconfig
# Copyright (C) 2015 Fabien Parent. All rights reserved.
# Author: Fabien Parent <parent.f@gmail.com>
#
# Provided under the three clause BSD license found in the LICENSE file.

config MACH_NAME
    string
    default "stm32"

config STM32_COMMON
    bool
    default y
    select LITTLE_ENDIAN

config STM32F4
    bool
    select STM32_COMMON
    select CPU_ARM_CORTEX_M4

config STM32F417XX
    bool
    select STM32F4

config BOARD_ARA_SVC
    bool
    select STM32F417XX

choice
    prompt "Board"

    config BOARD_ARA_SVC_BDB1B
        bool "BDB1B - ARA SVC"
        select BOARD_ARA_SVC

    config BOARD_ARA_SVC_BDB2
        bool "BDB2 - ARA SVC"
        select BOARD_ARA_SVC

    config BOARD_ARA_SVC_SDB
        bool "SDB - ARA SVC"
        select BOARD_ARA_SVC
endchoice

config MACH_LINKER_SCRIPT
    string
    default "stm32f417xx"
```

## arch/arm/mach-tsb/Kconfig
```kconfig
# Copyright (c) 2014-2015 Google Inc.
# All rights reserved.
#
# Redistribution and use in source and binary forms, with or without
# modification, are permitted provided that the following conditions are met:
# 1. Redistributions of source code must retain the above copyright notice,
# this list of conditions and the following disclaimer.
# 2. Redistributions in binary form must reproduce the above copyright notice,
# this list of conditions and the following disclaimer in the documentation
# and/or other materials provided with the distribution.
# 3. Neither the name of the copyright holder nor the names of its
# contributors may be used to endorse or promote products derived from this
# software without specific prior written permission.
#
# THIS SOFTWARE IS PROVIDED BY THE COPYRIGHT HOLDERS AND CONTRIBUTORS "AS IS"
# AND ANY EXPRESS OR IMPLIED WARRANTIES, INCLUDING, BUT NOT LIMITED TO,
# THE IMPLIED WARRANTIES OF MERCHANTABILITY AND FITNESS FOR A PARTICULAR
# PURPOSE ARE DISCLAIMED. IN NO EVENT SHALL THE COPYRIGHT HOLDER OR
# CONTRIBUTORS BE LIABLE FOR ANY DIRECT, INDIRECT, INCIDENTAL, SPECIAL,
# EXEMPLARY, OR CONSEQUENTIAL DAMAGES (INCLUDING, BUT NOT LIMITED TO,
# PROCUREMENT OF SUBSTITUTE GOODS OR SERVICES; LOSS OF USE, DATA, OR PROFITS;
# OR BUSINESS INTERRUPTION) HOWEVER CAUSED AND ON ANY THEORY OF LIABILITY,
# WHETHER IN CONTRACT, STRICT LIABILITY, OR TORT (INCLUDING NEGLIGENCE OR
# OTHERWISE) ARISING IN ANY WAY OUT OF THE USE OF THIS SOFTWARE, EVEN IF
# ADVISED OF THE POSSIBILITY OF SUCH DAMAGE.

config MACH_NAME
    string
    default "tsb"

config MACH_TSB_COMMON
    bool
    default y
    select CPU_ARM_CORTEX_M3
    select LITTLE_ENDIAN

choice
    prompt "Board"

    config TSB_BOARD_BDB
        bool "BDB"
        select MACH_TSB_COMMON

    config TSB_BOARD_ENDO
        bool "endoskeleton"
        select MACH_TSB_COMMON
endchoice

choice
    prompt "Chip Revision"

    config TSB_ES1
        bool "ES1"

    config TSB_ES2
        bool "ES2"
endchoice

choice
    prompt "Bridge configuration"

    config TSB_APB2
        bool "APB2"
        depends on TSB_BOARD_BDB
endchoice

config MACH_LINKER_SCRIPT
    string
    default "tsb-es1" if TSB_ES1
    default "tsb-es2" if TSB_ES2

config TSB_GPIO
    bool "TSB GPIO"
    depends on GPIO
    default y

config TSB_UNIPRO
    bool "TSB UniPro"
    depends on UNIPRO
    default y
```

## drivers/Kconfig
```kconfig
# Copyright (C) 2014-2015 Fabien Parent. All rights reserved.
# Author: Fabien Parent <parent.f@gmail.com>
#
# Provided under the three clause BSD license found in the LICENSE file.

menu "Drivers"

choice
    prompt "Watchdog"
    default NO_WATCHDOG

    config SCHEDULER_WATCHDOG
        bool "Watchdog provided by the scheduler"
        depends on ARCH_HAS_SCHEDULER_WATCHDOG
endchoice

menuconfig SERIAL
    bool "Serial"

if SERIAL
source drivers/serial/Kconfig
endif

menuconfig UNIPRO
    bool "UniPro"

if UNIPRO
source drivers/unipro/Kconfig
endif

endmenu
```

## drivers/gpio/Kconfig
```kconfig
# Copyright (C) 2014-2015 Fabien Parent. All rights reserved.
# Author: Fabien Parent <parent.f@gmail.com>
#
# Provided under the three clause BSD license found in the LICENSE file.

config TCA6408
    bool "TCA6408 support"

config TCA64XX
    bool "TCA64xx support"
```

## drivers/greybus/ap/Kconfig
```kconfig
# Copyright (C) 2015 Fabien Parent. All rights reserved.
# Author: Fabien Parent <parent.f@gmail.com>
#
# Provided under the three clause BSD license found in the LICENSE file.

menu "AP"

config GREYBUS_AP_GPIO
    bool "GPIO PHY"
    select GPIO

config GREYBUS_AP_I2C
    bool "I2C PHY"
    select I2C

config GREYBUS_AP_UART
    bool "UART PHY"
    select SERIAL

endmenu
```

## drivers/i2c/Kconfig
```kconfig
# Copyright (C) 2014-2015 Fabien Parent. All rights reserved.
# Author: Fabien Parent <parent.f@gmail.com>
#
# Provided under the three clause BSD license found in the LICENSE file.

config I2C_DW
    bool "Designware I2C support"

config STM32_I2C
    bool "STM32 I2C"
```

## drivers/serial/Kconfig
```kconfig
# Copyright (C) 2015 Fabien Parent. All rights reserved.
# Author: Fabien Parent <parent.f@gmail.com>
#
# Provided under the three clause BSD license found in the LICENSE file.

menuconfig UART16550
    bool "UART 16550"

if UART16550
config UART16550_FIFO_DEPTH
    int "FIFO Depth"
    default 16

config UART16550_RX_BUFFER_SIZE
    int "RX Buffer Size"
    default "64"

config UART16550_TX_BUFFER_SIZE
    int "TX Buffer Size"
    default "64"
endif

menuconfig STM32_USART
    bool "STM32 USART"

config TTY_MAX_CANON
    int "Maximum number of bytes in a canonical input line"
    default "256"

config TTY_MAX_INPUT
    int "Maximum input buffer size"
    default "256"

config TTY_MAX_OUTPUT
    int "Maximum output buffer size"
    default "256"
```

## drivers/unipro/Kconfig
```kconfig
config UNIPRO_TSB
    bool "TSB UniPro Support"

config UNIPRO_T6WT0XBG
    bool "TSB T6WT0XBG Unipro"
```

## drivers/usb/Kconfig
```kconfig
# Copyright (C) 2014-2015 Fabien Parent. All rights reserved.
# Author: Fabien Parent <parent.f@gmail.com>
#
# Provided under the three clause BSD license found in the LICENSE file.

config USB_HOST
    bool "Host support"
    default y

config USB_DEVICE
    bool "Device support"
    default y
```

## fs/Kconfig
```kconfig
# Copyright (C) 2015 Fabien Parent. All rights reserved.
# Author: Fabien Parent <parent.f@gmail.com>
#
# Provided under the three clause BSD license found in the LICENSE file.

menu "Filesystem"

menu "ramfs"
    config RAMFS_MAX_FILENAME_SIZE
        int "Max filename size"
        default 255

    config RAMFS_DATA_BLOCK_SIZE
        int "Data block size"
        default 256
endmenu

config PROCFS
    bool "procfs"

config BINFS
    bool "bin FS"
    default n

endmenu
```

## kernel/Kconfig
```kconfig
# Copyright (C) 2014-2015 Fabien Parent. All rights reserved.
# Author: Fabien Parent <parent.f@gmail.com>
#
# Provided under the three clause BSD license found in the LICENSE file.

menu "Kernel configuration"

config DEBUG
    bool "Debug"

config TICKLESS
    bool "Tickless"

menu "Scheduler"
    config SCHED_RR
        bool "SCHED_RR scheduling policy"

    config SCHED_FIFO
        bool "SCHED_FIFO scheduling policy"

    config SCHED_NUM_RR_PRIORITIES
        int "Number of available SCHED_RR priorities"
        default 32
        depends on SCHED_RR

    config SCHED_NUM_FIFO_PRIORITIES
        int "Number of available SCHED_FIFO priorities"
        default 32
        depends on SCHED_FIFO

    choice
        prompt "Scheduler default policy"
        default SCHED_DEFAULT_POLICY_RR if SCHED_RR

        config SCHED_DEFAULT_POLICY_RR
            bool "SCHED_RR"
            depends on SCHED_RR

        config SCHED_DEFAULT_POLICY_FIFO
            bool "SCHED_FIFO"
            depends on SCHED_FIFO
    endchoice
endmenu

config INIT_TASK_NAME
    string "Init task name"
    default "shell_main"

menu "Binary loaders"
    config ELF
        bool "ELF Binary loader"
endmenu

endmenu
```

## scripts/Kconfig
```kconfig
# Copyright (C) 2014-2015 Fabien Parent. All rights reserved.
# Author: Fabien Parent <parent.f@gmail.com>
#
# Provided under the three clause BSD license found in the LICENSE file.

menu "Compilation"

choice TOOLCHAIN
    prompt "Toolchain"
    default TOOLCHAIN_CLANG

    config TOOLCHAIN_CLANG
        bool "LLVM/CLang"

    config TOOLCHAIN_GCC
        bool "gcc"
endchoice

config OPTIMIZATION_LEVEL
    string "Optimization Level"
    default "-Os"

endmenu
```
