/*
 * Copyright (C) 2014-2015 Fabien Parent. All rights reserved.
 * Author: Fabien Parent <parent.f@gmail.com>
 *
 * Provided under the three clause BSD license found in the LICENSE file.
 */

#include <asm/linker-utils.h>

SECTIONS
{
    .data : {
        _shell_command = .;
        KEEP(*(.shell_cmd))
        _eshell_command = .;
    } DATA_STORAGE

    .heap : {
        _sheap = .;
    } > SRAM
}
